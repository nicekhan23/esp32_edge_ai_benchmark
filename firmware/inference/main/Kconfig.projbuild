## firmware/inference/main/Kconfig.projbuild
```kconfig
menu "Signal Inference Configuration"

    config INFERENCE_SAMPLE_WINDOW_SIZE
        int "Sample window size"
        range 64 1024
        default 256
        help
            Number of samples per inference window.

    config INFERENCE_USE_FFT
        bool "Use FFT for feature extraction"
        default n
        help
            Enable FFT-based feature extraction before inference.

    config INFERENCE_PREPROCESS_OPTIONS
        hex "Preprocessing options"
        default 0x03
        help
            Bitmask of preprocessing options (DC removal, normalization, windowing).

    config INFERENCE_UART_BAUD_RATE
        int "UART baud rate for labels"
        default 115200
        help
            Baud rate for receiving ground-truth labels.

    config INFERENCE_LOG_LEVEL
        int "Log level"
        range 0 5
        default 3
        help
            ESP_LOG level (0-5, higher = more verbose).

    choice MODEL_SELECTION
        prompt "Select Model"
        default MODEL_CNN_INT8
        help
            Select which model to include in the firmware.
            
        config MODEL_CNN_INT8
            bool "CNN INT8 Model"
        config MODEL_CNN_FLOAT32
            bool "CNN Float32 Model"
        config MODEL_MLP_FLOAT32
            bool "MLP Float32 Model"
        config MODEL_MLP_INT8
            bool "MLP INT8 Model"
        config MODEL_HYBRID_FLOAT32
            bool "Hybrid Float32 Model"
        config MODEL_HYBRID_INT8
            bool "Hybrid INT8 Model"
        config MODEL_HEURISTIC_ONLY
            bool "Heuristic Only (No TFLite)"
    endchoice
endmenu
```
